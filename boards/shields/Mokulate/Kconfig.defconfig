## boards/shields/Mokulate/Kconfig.defconfig
```kconfig
if MOKULATE_RIGHT

config ZMK_KEYBOARD_NAME
    default "Mokulate"

config ZMK_SPLIT_ROLE_CENTRAL
    default y

endif

if MOKULATE_LEFT || MOKULATE_RIGHT

config ZMK_SPLIT
    default y

config ZMK_POINTING     # paw3222
    default y

config PAW3222      # paw3222
    default y


endif
```
